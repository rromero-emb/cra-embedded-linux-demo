## br2-external/board/qemu-aarch64-cra/fit-image.its
```
/*
 * FIT del sistema: kernel + device tree, con hash SHA-256 de cada pieza y la
 * CONFIGURACIÓN firmada (RSA-4096). U-Boot exige la firma (required = "conf"):
 * no arranca nada que no esté firmado por la clave integrada en su device tree.
 * Firmar la configuración (y no cada imagen por separado) impide combinar piezas
 * firmadas de versiones distintas ("mix-and-match").
 */
/dts-v1/;

/ {
	description = "CRA demo - kernel firmado";
	#address-cells = <1>;

	images {
		kernel-1 {
			description = "Linux kernel";
			data = /incbin/("Image");
			type = "kernel";
			arch = "arm64";
			os = "linux";
			compression = "none";
			load = <0x40400000>;
			entry = <0x40400000>;
			hash-1 {
				algo = "sha256";
			};
		};
		fdt-1 {
			description = "Device tree de la máquina";
			data = /incbin/("qemu-cra.dtb");
			type = "flat_dt";
			arch = "arm64";
			compression = "none";
			hash-1 {
				algo = "sha256";
			};
		};
	};

	configurations {
		default = "conf-1";
		conf-1 {
			description = "Arranque firmado";
			kernel = "kernel-1";
			fdt = "fdt-1";
			signature-1 {
				algo = "sha256,rsa4096";
				key-name-hint = "cra-dev";
				sign-images = "kernel", "fdt";
			};
		};
	};
};
```

## br2-external/configs/qemu_aarch64_cra_defconfig
```kconfig
# --- Arquitectura y toolchain -------------------------------------------------
BR2_aarch64=y
BR2_cortex_a53=y
BR2_TOOLCHAIN_EXTERNAL=y
BR2_TOOLCHAIN_EXTERNAL_BOOTLIN=y
BR2_TOOLCHAIN_EXTERNAL_BOOTLIN_AARCH64_GLIBC_STABLE=y
BR2_CCACHE=y
BR2_DOWNLOAD_FORCE_CHECK_HASHES=y
BR2_GLOBAL_PATCH_DIR="$(BR2_EXTERNAL_CRA_DEMO_PATH)/patches"
# Endurecimiento de binarios (PIE, SSP fuerte y RELRO completo ya son el valor por defecto)
BR2_PIC_PIE=y
BR2_SSP_STRONG=y
BR2_RELRO_FULL=y
BR2_FORTIFY_SOURCE_2=y

# --- Sistema ------------------------------------------------------------------
BR2_TARGET_GENERIC_HOSTNAME="cra-demo"
BR2_TARGET_GENERIC_ISSUE="CRA demo - Linux embebido"
BR2_SYSTEM_DHCP="eth0"
# Sin contraseña de root: cuenta bloqueada. Acceso solo por SSH con clave (usuario admin)
# BR2_TARGET_ENABLE_ROOT_LOGIN is not set
BR2_ROOTFS_USERS_TABLES="$(BR2_EXTERNAL_CRA_DEMO_PATH)/board/qemu-aarch64-cra/users.txt"
BR2_ROOTFS_DEVICE_TABLE="system/device_table.txt $(BR2_EXTERNAL_CRA_DEMO_PATH)/board/qemu-aarch64-cra/permissions.txt"
BR2_ROOTFS_OVERLAY="$(BR2_EXTERNAL_CRA_DEMO_PATH)/board/qemu-aarch64-cra/rootfs-overlay"
BR2_ROOTFS_POST_BUILD_SCRIPT="$(BR2_EXTERNAL_CRA_DEMO_PATH)/board/qemu-aarch64-cra/post-build.sh"
BR2_ROOTFS_POST_IMAGE_SCRIPT="support/scripts/genimage.sh"
BR2_ROOTFS_POST_SCRIPT_ARGS="-c $(BR2_EXTERNAL_CRA_DEMO_PATH)/board/qemu-aarch64-cra/genimage.cfg"

# --- Servicios: solo SSH (dropbear) y cortafuegos ---
BR2_PACKAGE_DROPBEAR=y
# BR2_PACKAGE_DROPBEAR_CLIENT is not set
BR2_PACKAGE_NFTABLES=y

# --- Kernel (6.12 LTS) --------------------------------------------------------
BR2_LINUX_KERNEL=y
BR2_LINUX_KERNEL_CUSTOM_VERSION=y
BR2_LINUX_KERNEL_CUSTOM_VERSION_VALUE="6.12.112"
BR2_LINUX_KERNEL_USE_CUSTOM_CONFIG=y
BR2_LINUX_KERNEL_CUSTOM_CONFIG_FILE="board/qemu/aarch64-virt/linux.config"
BR2_LINUX_KERNEL_CONFIG_FRAGMENT_FILES="$(BR2_EXTERNAL_CRA_DEMO_PATH)/board/qemu-aarch64-cra/linux.fragment"
BR2_LINUX_KERNEL_NEEDS_HOST_OPENSSL=y
BR2_LINUX_KERNEL_INSTALL_TARGET=y

# --- Bootloader: U-Boot como firmware de QEMU ---------------------------------
BR2_TARGET_UBOOT=y
BR2_TARGET_UBOOT_BUILD_SYSTEM_KCONFIG=y
BR2_TARGET_UBOOT_CUSTOM_VERSION=y
BR2_TARGET_UBOOT_CUSTOM_VERSION_VALUE="2026.07"
BR2_TARGET_UBOOT_BOARD_DEFCONFIG="qemu_arm64"
BR2_TARGET_UBOOT_CONFIG_FRAGMENT_FILES="$(BR2_EXTERNAL_CRA_DEMO_PATH)/board/qemu-aarch64-cra/uboot.fragment"
BR2_TARGET_UBOOT_NEEDS_OPENSSL=y
BR2_TARGET_UBOOT_NEEDS_GNUTLS=y

# --- Sistema de ficheros e imagen de disco ------------------------------------
BR2_TARGET_ROOTFS_EXT2=y
BR2_TARGET_ROOTFS_EXT2_4=y
BR2_TARGET_ROOTFS_EXT2_SIZE="128M"
# BR2_TARGET_ROOTFS_TAR is not set

# --- Herramientas de host -----------------------------------------------------
BR2_PACKAGE_HOST_GENIMAGE=y
BR2_PACKAGE_HOST_UBOOT_TOOLS=y
BR2_PACKAGE_HOST_UBOOT_TOOLS_FIT_SUPPORT=y
BR2_PACKAGE_HOST_UBOOT_TOOLS_FIT_SIGNATURE_SUPPORT=y
```
